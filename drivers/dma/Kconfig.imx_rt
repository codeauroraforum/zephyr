## drivers/dma/Kconfig.imx_rt
```kconfig
# DMA configuration options

# Copyright (c) 2016 Intel Corporation
# Copyright (c) 2019 Song Qiang <songqiang1304521@gmail.com>
# SPDX-License-Identifier: Apache-2.0

config DMA_IMX_RT
	bool "Enable IMX RT DMA driver"
	depends on SOC_SERIES_IMX_RT
	help
	  DMA driver for IMX RT series SoCs.

if DMA_IMX_RT

config DMA_TCD_QUEUE_SIZE
	int "number of TCD in a queue for SG mode"
	default 2
	help
	  number of TCD in a queue for SG mode


endif # DMA_IMX_RT
```

## dts/bindings/dma/nxp,imx-xbara.yaml
```yaml
# Copyright (c) 2020, NXP
# SPDX-License-Identifier: Apache-2.0

description: NXP IMX XBARA controller

compatible: "nxp,imx-xbara"

include: base.yaml

properties:
    reg:
      required: true

    "#xbara-cells":
      type: int
      required: true
      description: Number of items to expect in a xbara
      const: 2

# Parameter syntax of NXP follows dts syntax
# in the Linux kernel declared in
# https://git.kernel.org/pub/scm/linux/kernel/git/devicetree/devicetree-rebasing.git/plain/Bindings/dma/stm32-dma.txt
#
# in0: xbara in 0
# in1: xbara in 1


xbara-cells:
  - in0
  - in2
```

## dts/bindings/dma/nxp,imx-xbarb.yaml
```yaml
# Copyright (c) 2020, NXP
# SPDX-License-Identifier: Apache-2.0

description: NXP IMX XBARB controller

compatible: "nxp,imx-xbarb"

include: base.yaml

properties:
    reg:
      required: true

    "#xbarb-cells":
      type: int
      required: true
      description: Number of items to expect in a xbarb
      const: 2

# Parameter syntax of NXP follows the client dts syntax
# in the Linux kernel declared in
# https://git.kernel.org/pub/scm/linux/kernel/git/devicetree/devicetree-rebasing.git/plain/Bindings/dma/stm32-dma.txt
#
# in0: xbara in 0
# in1: xbara in 1


xbarb-cells:
  - in0
  - in2
```

## dts/bindings/usb/nxp,lpc-usbd.yaml
```yaml
# Copyright (c) 2018 PHYTEC Messtechnik GmbH
# SPDX-License-Identifier: Apache-2.0

description: |
    NPX LPC USBFSOTG Controller in device mode

compatible: "nxp,lpc-usbd"

include: usb-ep.yaml

properties:
    reg:
      required: true

    interrupts:
      required: true
```

## ext/lib/ipc/erpc/Kconfig
```kconfig
# Kconfig - Shell configuration options

#
# Copyright 2018 NXP
#
# SPDX-License-Identifier: Apache-2.0
#

config IPC_ERPC
	bool
	prompt "Enable embedded Remote Procesure Call"
	default n
	help
	embedded Remote Procesure Call implementation.
```
